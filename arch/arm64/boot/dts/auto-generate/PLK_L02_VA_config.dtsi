
/**
 * Huawei Ltd.
 * PhosphorV660
 */


/include/ "PLK_TL00H_VA_config.dtsi"

/ {
	hisi,boardid = <1 8 0 6 >;
	hisi,boardname = "PLK_L02_VA";
	hisi,modem_id = <0x3EB52580>;

	bcm_wifi {
		wifi_nvram_name = "/vendor/firmware/nvram4339_hw_plk_l02.txt";
	};

	antenna_fpga{
		compatible = "antenna_fpga";
		antenna_fpga,pre-image-filename = "PLK-L02-VA.bin";
		status = "ok";
	};
};

