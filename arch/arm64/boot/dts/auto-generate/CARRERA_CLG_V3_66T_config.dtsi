
/**
 * Huawei Ltd.
 * PhosphorV660
 */


/include/ "CARRERA_CLG_V3_config.dtsi"

/ {
	hisi,boardid = <1 4 9 2 >;
	hisi,boardname = "CARRERA_CLG_V3_66T";
	amba {
		i2c1: i2c@FDF0A000 {
			pn547_nfc:nfc@28 {
				nfc_card_num = <0x2>;
				nfc_chip_type = "pn66t";
				status = "ok";
			};
		};
	};
};

