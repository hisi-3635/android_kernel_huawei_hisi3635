
/**
 * Huawei Ltd.
 * PhosphorV660
 */


/include/ "CARRERA_TUGL_VN2_32G_config.dtsi"

/ {
	hisi,boardid = <1 4 8 7 >;
	hisi,boardname = "CARRERA_TUGL_VN2";
	hisi,config_profile = "highhigh";
	sensorhub{
		als_sensor:light{
			als1{
				als_phone_version = <12>;
			};
		};
	};
};

