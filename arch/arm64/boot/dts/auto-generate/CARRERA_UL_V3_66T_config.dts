
/**
 * Huawei Ltd.
 * PhosphorV660
 */

/dts-v1/;

/include/ "fastboot.dtsi"
/include/ "CARRERA_UL_V3_config.dtsi"
/include/ "CARRERA_UL_V3_66T_pin.dtsi"
/include/ "CARRERA_UL_V3_66T_hi6402_pin.dtsi"
/include/ "CARRERA_UL_V3_66T_modem_pin.dtsi"
///include/ "CARRERA_UL_V3_66T_charger.dtsi"
///include/ "CARRERA_UL_V3_66T_pmic.dtsi"
///include/ "CARRERA_UL_V3_66T_gpio_logic.dtsi"

/ {
	hisi,boardid = <1 4 8 2 >;
	hisi,boardname = "CARRERA_UL_V3_66T";
	amba {
		i2c1: i2c@FDF0A000 {
			pn547_nfc:nfc@28 {
				nfc_card_num = <0x2>;
				nfc_nxp_name = "libnfc_nxp_carrera.conf";
				nfc_brcm_conf_name = "libnfc_brcm_carrera.conf";
				nfc_chip_type = "pn66t";
				status = "ok";
			};
		};
	};
};

