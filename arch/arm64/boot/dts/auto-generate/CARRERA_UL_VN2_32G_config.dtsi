
/**
 * Huawei Ltd.
 * PhosphorV660
 */


/include/ "CARRERA_UL_VN1_66T_FPGA_config.dtsi"

/ {
	hisi,boardid = <1 4 7 6 >;
	hisi,boardname = "CARRERA_UL_VN2_32G";
	hisi,config_profile = "normal";
	sensorhub{
		als_sensor:light{
			als1{
				als_phone_version = <12>;
			};
		};
	};
};

