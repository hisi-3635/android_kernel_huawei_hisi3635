
/**
 * Huawei Ltd.
 * PhosphorV660
 */

/dts-v1/;

/include/ "fastboot.dtsi"
/include/ "CARRERA_UL_VN2_32G_config.dtsi"
/include/ "CARRERA_UL_VN2_pin.dtsi"
/include/ "CARRERA_UL_VN2_hi6402_pin.dtsi"
/include/ "CARRERA_UL_VN2_modem_pin.dtsi"
///include/ "CARRERA_UL_VN2_charger.dtsi"
///include/ "CARRERA_UL_VN2_pmic.dtsi"
///include/ "CARRERA_UL_VN2_gpio_logic.dtsi"

/ {
	hisi,boardid = <1 4 7 7 >;
	hisi,boardname = "CARRERA_UL_VN2";
	hisi,config_profile = "highhigh";
	sensorhub{
		als_sensor:light{
			als1{
				als_phone_version = <12>;
			};
		};
	};
};

