
/**
 * Huawei Ltd.
 * PhosphorV660
 */


/include/ "CARRERA_TUGL_VN1_66T_config.dtsi"

/ {
	hisi,boardid = <1 4 8 5 >;
	hisi,boardname = "CARRERA_TUGL_VN1_FPGA";
	antenna_fpga{
		compatible = "antenna_fpga";
		antenna_fpga,power-disable = <1>;
		antenna_fpga,pre-image-filename = "CARRERA-TULG-VN2.bin";
		status = "ok";
	};
};

