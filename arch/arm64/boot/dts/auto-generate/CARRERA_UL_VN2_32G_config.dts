
/**
 * Huawei Ltd.
 * PhosphorV660
 */

/dts-v1/;

/include/ "fastboot.dtsi"
/include/ "CARRERA_UL_VN1_66T_FPGA_config.dtsi"
/include/ "CARRERA_UL_VN2_32G_pin.dtsi"
/include/ "CARRERA_UL_VN2_32G_hi6402_pin.dtsi"
/include/ "CARRERA_UL_VN2_32G_modem_pin.dtsi"
///include/ "CARRERA_UL_VN2_32G_charger.dtsi"
///include/ "CARRERA_UL_VN2_32G_pmic.dtsi"
///include/ "CARRERA_UL_VN2_32G_gpio_logic.dtsi"

/ {
	hisi,boardid = <1 4 7 6 >;
	hisi,boardname = "CARRERA_UL_VN2_32G";
	hisi,config_profile = "normal";
	sensorhub{
		als_sensor:light{
			als1{
				als_phone_version = <12>;
			};
		};
	};
};

