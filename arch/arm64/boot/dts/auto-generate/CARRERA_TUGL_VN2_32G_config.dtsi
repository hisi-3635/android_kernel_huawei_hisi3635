
/**
 * Huawei Ltd.
 * PhosphorV660
 */


/include/ "CARRERA_TUGL_VN1_FPGA_config.dtsi"

/ {
	hisi,boardid = <1 4 8 6 >;
	hisi,boardname = "CARRERA_TUGL_VN2_32G";
	hisi,config_profile = "normal";
	sensorhub{
		als_sensor:light{
			als1{
				als_phone_version = <12>;
			};
		};
	};
};

