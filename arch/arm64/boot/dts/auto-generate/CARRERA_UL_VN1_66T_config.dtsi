
/**
 * Huawei Ltd.
 * PhosphorV660
 */


/include/ "CARRERA_UL_V4_66T_config.dtsi"

/ {
	hisi,boardid = <1 4 7 4 >;
	hisi,boardname = "CARRERA_UL_VN1_66T";
	hisi,modem_id = <0x3EB08400>;
	sensorhub{
		als_sensor:light{
			als1{
				als_phone_version = <11>;
			};
		};
	};
};

