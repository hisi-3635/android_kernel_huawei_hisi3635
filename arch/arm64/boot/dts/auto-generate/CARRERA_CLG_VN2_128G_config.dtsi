
/**
 * Huawei Ltd.
 * PhosphorV660
 */


/include/ "fastboot.dtsi"
/include/ "CARRERA_CLG_VN2_32G_config.dtsi"
/include/ "CARRERA_CLG_VN2_128G_pin.dtsi"
/include/ "CARRERA_CLG_VN2_128G_hi6402_pin.dtsi"
/include/ "CARRERA_CLG_VN2_128G_modem_pin.dtsi"
///include/ "CARRERA_CLG_VN2_128G_charger.dtsi"
///include/ "CARRERA_CLG_VN2_128G_pmic.dtsi"
///include/ "CARRERA_CLG_VN2_128G_gpio_logic.dtsi"

/ {
	hisi,boardid = <1 4 9 7 >;
	hisi,boardname = "CARRERA_CLG_VN2_128G";
	hisi,config_profile = "highhigh";
	sensorhub{
		als_sensor:light{
			als1{
				als_phone_version = <12>;
			};
		};
	};
};

