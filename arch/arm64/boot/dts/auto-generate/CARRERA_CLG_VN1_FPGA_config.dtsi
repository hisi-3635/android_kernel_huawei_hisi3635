
/**
 * Huawei Ltd.
 * PhosphorV660
 */


/include/ "CARRERA_CLG_VN1_66T_config.dtsi"

/ {
	hisi,boardid = <1 4 9 5 >;
	hisi,boardname = "CARRERA_CLG_VN1_FPGA";
	antenna_fpga{
		compatible = "antenna_fpga";
		antenna_fpga,power-disable = <1>;
		antenna_fpga,pre-image-filename = "CARRERA_CLG_VN2.bin";
		status = "ok";
	};
};

