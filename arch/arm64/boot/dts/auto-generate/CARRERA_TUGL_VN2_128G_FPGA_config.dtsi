
/**
 * Huawei Ltd.
 * PhosphorV660
 */


/include/ "fastboot.dtsi"
/include/ "CARRERA_TUGL_VN2_128G_config.dtsi"
/include/ "CARRERA_TUGL_VN2_128G_FPGA_pin.dtsi"
/include/ "CARRERA_TUGL_VN2_128G_FPGA_hi6402_pin.dtsi"
/include/ "CARRERA_TUGL_VN2_128G_FPGA_modem_pin.dtsi"
///include/ "CARRERA_TUGL_VN2_128G_FPGA_charger.dtsi"
///include/ "CARRERA_TUGL_VN2_128G_FPGA_pmic.dtsi"
///include/ "CARRERA_TUGL_VN2_128G_FPGA_gpio_logic.dtsi"

/ {
	hisi,boardid = <1 4 8 8 >;
	hisi,boardname = "CARRERA_TUGL_VN2_128G_FPGA";
	hisi,config_profile = "highhigh";
	sensorhub{
		als_sensor:light{
			als1{
				als_phone_version = <12>;
			};
		};
	};
};

