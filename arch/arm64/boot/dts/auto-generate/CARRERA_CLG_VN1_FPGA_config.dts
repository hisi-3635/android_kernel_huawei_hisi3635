
/**
 * Huawei Ltd.
 * PhosphorV660
 */

/dts-v1/;

/include/ "fastboot.dtsi"
/include/ "CARRERA_CLG_VN1_66T_config.dtsi"
/include/ "CARRERA_CLG_VN1_FPGA_pin.dtsi"
/include/ "CARRERA_CLG_VN1_FPGA_hi6402_pin.dtsi"
/include/ "CARRERA_CLG_VN1_FPGA_modem_pin.dtsi"
///include/ "CARRERA_CLG_VN1_FPGA_charger.dtsi"
///include/ "CARRERA_CLG_VN1_FPGA_pmic.dtsi"
///include/ "CARRERA_CLG_VN1_FPGA_gpio_logic.dtsi"

/ {
	hisi,boardid = <1 4 9 5 >;
	hisi,boardname = "CARRERA_CLG_VN1_FPGA";
	antenna_fpga{
		compatible = "antenna_fpga";
		antenna_fpga,power-disable = <1>;
		antenna_fpga,pre-image-filename = "CARRERA_CLG_VN2.bin";
		status = "ok";
	};
};

