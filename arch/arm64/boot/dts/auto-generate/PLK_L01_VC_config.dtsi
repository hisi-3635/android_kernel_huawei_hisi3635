
/**
 * Huawei Ltd.
 * PhosphorV660
 */


/include/ "PLK_L01_VB_config.dtsi"

/ {
	hisi,boardid = <1 8 8 3 >;
	hisi,boardname = "PLK_L01_VC";
	hisi,sub_platform_info0 = "Kirin935";

	target-cpu {
		compatible = "hisi,targetcpu";
		target_cpu = "Kirin 935";
	};

	panel_lcd_jdi_NT35695 {
		lcd-bl-type = <8>;
	};

};

