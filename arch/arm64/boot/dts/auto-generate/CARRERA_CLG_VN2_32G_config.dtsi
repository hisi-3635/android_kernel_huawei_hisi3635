
/**
 * Huawei Ltd.
 * PhosphorV660
 */


/include/ "CARRERA_CLG_VN1_FPGA_config.dtsi"

/ {
	hisi,boardid = <1 4 9 6 >;
	hisi,boardname = "CARRERA_CLG_VN2_32G";
	hisi,config_profile = "normal";
	sensorhub{
		als_sensor:light{
			als1{
				als_phone_version = <12>;
			};
		};
	};
};

