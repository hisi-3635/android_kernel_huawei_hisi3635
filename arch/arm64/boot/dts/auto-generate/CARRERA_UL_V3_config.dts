
/**
 * Huawei Ltd.
 * PhosphorV660
 */

/dts-v1/;

/include/ "fastboot.dtsi"
/include/ "CARRERA_UL_V1_config.dtsi"
/include/ "CARRERA_UL_V3_pin.dtsi"
/include/ "CARRERA_UL_V3_hi6402_pin.dtsi"
/include/ "CARRERA_UL_V3_modem_pin.dtsi"
///include/ "CARRERA_UL_V3_charger.dtsi"
///include/ "CARRERA_UL_V3_pmic.dtsi"
///include/ "CARRERA_UL_V3_gpio_logic.dtsi"

/ {
	hisi,boardid = <1 4 7 1 >;
	hisi,boardname = "CARRERA_UL_V3";
};

